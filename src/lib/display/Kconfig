## src/lib/display/Kconfig
```kconfig
# INKI_DISPLAY drivers

# Copyright (c) 2017 Intel Corporation
# Copyright (c) 2022 INKI-Systems Inc
# Licensed under GPL 3

menuconfig INKI_DISPLAY
	bool "INKI-optimised display Drivers"
	help
	  Enable INKI_DISPLAY drivers
	  
config INKI_DISPLAY
	bool "INKI-optimised display Drivers"
	help
	  Enable INKI_DISPLAY drivers

if INKI_DISPLAY

module = INKI_DISPLAY
module-str = inki_display
source "subsys/logging/Kconfig.template.log_config"

rsource "inki_ssd16xx/Kconfig.inki_ssd16xx"

config FRAMEBUF_INKI_DISPLAY
	# Hidden, selected by client drivers.
	bool
	help
	  Enable framebuffer-based INKI-display 'helper' driver.

endif # INKI_DISPLAY
```

## src/lib/display/inki_ssd16xx/Kconfig.inki_ssd16xx
```kconfig
# SSD16XX display controller configuration options

# Copyright (c) 2018 Phytec Messtechnik GmbH
# Copyright (c) 2022 INKI-Systems Inc
# Licensed under GPL 3

config INKI_SSD16XX
	bool "INKI-customised SSD16XX compatible display controller driver"
	depends on SPI
	help
	  Enable INKI driver for SSD16XX compatible controller.
```

## src/lib/fs/Kconfig
```kconfig
# INKI_XIPA_FS drivers

# 	Copyright (c) 2021 INKI-Systems Inc.
#
#	Licensed under GPL 3
#
#

menuconfig INKI_XIPA_FS
	bool "INKI's custom XIPA_FS file system"
	help
	  Enable INKI_XIPA filesystem
	  
config INKI_XIPA_FS
	bool "INKI's custom XIPA file system"
	help
	  Enable INKI_XIPA filesystem 

if INKI_XIPA_FS

config INKI_XIPA_DRV_EXISTS
	bool #hidden 
	help
	  Private! Selected by driver.

module = INKI_XIPA_FS
module-str = inki_xipa_fs
source "subsys/logging/Kconfig.template.log_config"

rsource "drivers/nrf_xip_nor/Kconfig.nrf_xip_nor"

endif # INKI_XIPA_FS
```

## src/lib/fs/drivers/nrf_xip_nor/Kconfig.nrf_xip_nor
```kconfig
# 	Copyright (c) 2021 INKI-Systems Inc.
#
#	Licensed under GPL 3

config XIPA_FS_NRF5XX
	bool "INKI-optimised display Drivers"
	help
	  Enable XIPA_FS driver for Nordic's NRF52 and NRF53 series of Bluetooth LE SoCs. 
	select INKI_XIPA_DRV_EXISTS
```

## src/lib/icc/Kconfig
```kconfig
# INKI_ICC - Inter Core Communication

# Copyright (c) 2022 INKI-Systems Inc
# Licensed under GPL 3
#
#	Licensed under GPL 3
#
#

menuconfig INKI_ICC
	bool "INKI's custom low-power inter core communication system"
	help
	  Enable INKI_ICC low-power core communication subsystem
	  
config INKI_ICC
	bool "INKI's custom low-power inter core communication system"
	

if INKI_ICC

config INKI_ICC_BKEND_EXISTS
	bool #hidden 
	help
	  Private! Selected by driver.

choice
	prompt "Select backend for ICC"
	depends on INKI_ICC

	config LP_UARTE
	tristate "Low-Power UARTE (with DMA)"
	depends on INKI_LP_UARTE;

	config LP_SPIE
	tristate "Low-Power SPI (with DMA)"
	depends on SPI;
	
endchoice
	
config INKI_ICC_LOG_LEVEL
	int "Set desired log level for ICC subsystem"
	help
	   Set log level for low power inter-core-communication module: (1 - Critical errors only, 2 - Warnings, 3 - Information)"

module = INKI_ICC
module-str = inki_icc
source "subsys/logging/Kconfig.template.log_config"


endif # INKI_ICC
```

## src/lib/lp_uarte/Kconfig
```kconfig
# INKI_LP_UARTE drivers

# Copyright (c) 2022 INKI-Systems Inc
# Licensed under GPL 3
#
#	Licensed under GPL 3
#
#

menuconfig INKI_LP_UARTE
	bool "INKI's custom low-power UART communication system"
	help
	  Enable INKI LP_UARTE subsystem
	select INKI_ICC_BKEND_EXISTS
	  
config INKI_LP_UARTE
	bool "INKI's custom low-power UART communication system"
	help
	  Enable INKI LP_UARTE subsystem 

if INKI_LP_UARTE

config INKI_LP_UARTE_DRV_EXISTS
	bool #hidden 
	help
	  Private! Selected by driver.
	
config INKI_LP_UARTE_RX_BUF_LEN
	int "Size of RX buffers - double buffered so this value muliplied by 2 is the total memory usage"
	help
	  Specify size of RX buffer. Internally they are double-buffered, so double this value to get total memory usage.

config INKI_LP_UARTE_TX_BUF_LEN
	int "Size of TX buffer - not internally double buffered"
	help
	  Specify size of TX buffer. Not double-buffered.

config INKI_LP_UARTE_LOG_LEVEL
	int "Set desired log level for low-power UARTE peripheral"
	help
	   Set log level for low power UARTE peripheral: (1 - Critical errors only, 2 - Warnings, 3 - Information)"

config INKI_LP_UARTE_IDENTIFIER
	string "Set identifier that MCUs will use to verify messages"
	help
	  "Set identifier prepended to every packet that MCU will verify (unless in enhanced file-write mode)"

config INKI_LP_UARTE_CB_PTRS
	int "Set desired length for internal TX/RX callback function array"
	help
	  "Set desired length for internal TX/RX callback function array"

module = INKI_LP_UARTE
module-str = inki_lp_uarte
source "subsys/logging/Kconfig.template.log_config"

rsource "drivers/nrf_lp_uarte/Kconfig.nrf_lp_uarte"

endif # INKI_LP_UARTE
```

## src/lib/lp_uarte/drivers/nrf_lp_uarte/Kconfig.nrf_lp_uarte
```kconfig
# Copyright (c) 2022 INKI-Systems Inc
# Licensed under GPL 3
#

config INKI_LP_UARTE_NRF52
    bool "INKI-optimised low power communication protocol"
	help
	  Enable LP_IARTE driver for Nordic's NRF52 series of Bluetooth LE SoCs. 
	select INKI_LP_UARTE_DRV_EXISTS

config INKI_LP_UARTE_NRF53
    bool "INKI-optimised low power communication protocol"
	help
	  Enable LP_IARTE driver for Nordic's NRF52 series of Bluetooth LE SoCs. 
	select INKI_LP_UARTE_DRV_EXISTS
```
